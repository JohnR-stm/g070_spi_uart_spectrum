#include <stdint.h>
#include "app_uart.h"

#include "uart.h"
#include "spi_hw.h"

//static char string1[] = "Hello, I'm STM32G070! \r\n";


uint8_t Buf_UART[CCD_SZx2] = {0};
uint16_t Buf_SPI[CCD_SZ] = {0};

uint8_t spi_flag = 0;
uint8_t uart_flag = 0;

//-----------------------------------------------------------------------------
// START DMA 
//-----------------------------------------------------------------------------

void start_dma_spi(void)
{
  spi_dma_buf ((uint32_t *)&Buf_SPI[0], CCD_SZ);
}

//-----------------------------------------------------------------------------
// uart1 HANDLER
//-----------------------------------------------------------------------------

void uart1_handler(void)
{
  uart_flag = 1;
  uint8_t val = uart1_read_byte(); // read byte
}

//-----------------------------------------------------------------------------
//  SPI1 HANDLER
//-----------------------------------------------------------------------------

void spi_handler(void)
{
  spi_flag = 1;
  start_dma_spi();
}

//-----------------------------------------------------------------------------
//
//-----------------------------------------------------------------------------

void data_processing(void)
{
  if(uart_flag == 1)
  {
    while (spi_flag == 0) 
    { 
      //--- delay untill spi not ready ---//
    };
    
    //--- copy Buf_SPI to Buf_UART ---//
    for(int i = 0; i < CCD_SZ; i++)
    {
      Buf_UART[i*2] = ((Buf_SPI[i]) >> 8) & 0xFF;
      Buf_UART[i*2 + 1] = (Buf_SPI[i]) & 0xFF;
    }
    
    //--- send to UART ---//
    uart1_send_buf(Buf_UART, CCD_SZx2);
    
    //--- clear bufers ---//
    for(uint16_t i = 0; i < CCD_SZ; i++)
      Buf_SPI[i] = 0;
    
    //--- reset flags ---//
    uart_flag = 0;
    spi_flag = 0; 
  }
}

//-----------------------------------------------------------------------------
//
//-----------------------------------------------------------------------------

void app_bufer_init(void)
{
  uint8_t val = 0;
  for(uint16_t i = 0; i<CCD_SZx2; i++)
  {
    Buf_UART[i] = val;
    val++;
    if (val>=255) val = 0;
  }
}

//-----------------------------------------------------------------------------
//
//-----------------------------------------------------------------------------


//-----------------------------------------------------------------------------
//
//-----------------------------------------------------------------------------

//-----------------------------------------------------------------------------
//
//-----------------------------------------------------------------------------